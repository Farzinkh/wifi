## Kconfig.projbuild
```kconfig
menu "WIFI Configuration"

	choice WIFI_MODE
		bool "Choose operation mode"
		default AP
		help
			station or accespoint.
		config AP
			bool "AP"
		config STA
			bool "STA"
		config SMART
			bool "SMART"    
	endchoice

	config WIFI_MODE
		int 
		default 1 if STA
		default 0 if AP
		default 2 if SMART
		
	config LWIP_LOCAL_HOSTNAME
		string "ESP NAME"
		depends on STA || SMART
		default "ESP_00"
		help
			ESP name in network.
				
	config ESP_AP_WIFI_SSID
		string "WiFi SSID FOR ESP"
		depends on AP || SMART
		default "myssid"
		help
			SSID (network name) for ESP.

	config ESP_AP_WIFI_PASSWORD
		string "WiFi Password FOR ESP"
		depends on AP || SMART
		default "mypassword"
		help
			WiFi password (WPA or WPA2) FOR ESP to use min length is 8 .
	
	config ESP_STA_WIFI_SSID
		string "WiFi SSID FOR ROUTER"
		depends on STA || SMART
		default "myssid2"
		help
			SSID (network name) FOR ROUTER to connect to.

	config ESP_STA_WIFI_PASSWORD
		string "WiFi Password FOR ROUTER"
		depends on STA || SMART
		default "mypassword2"
		help
			WiFi password (WPA or WPA2) FOR ROUTER to use min length is 8 . 

	config ESP_MAXIMUM_RETRY
		int "Maximum retry"
		depends on STA || SMART
		default 5
		help
			Set the Maximum retry to avoid station reconnecting to the AP unlimited when the AP is really inexistent.
	config SCAN_LIST_SIZE
		int "Max size of scan list"
		range 0 20
		default 10
		help
			The size of array that will be used to retrieve the list of access points.			
	config ESP_MAX_STA_CONN
		int "Maximal STA connections"
		depends on AP || SMART
		default 4
		help
			Max number of the STA connects to AP.
	config ESP_WIFI_CHANNEL
		int "WiFi Channel"
		depends on AP || SMART
		range 1 13
		default 1
		help
			WiFi channel (network channel) for the OTA to use. 		
	config MDNS_HOSTNAME
		string "mDNS Hostname"
		default "ftp-server"
		help
			mDNS Hostname for FTP Server.

	config STATIC_IP
		bool "Enable Static IP Address"
		default false
		help
			Enable Static IP Address.

	config STATIC_IP_ADDRESS
		depends on STATIC_IP
		string "Static IP Address"
		default "192.168.10.100"
		help
			Static IP Address for Station.

	config STATIC_GW_ADDRESS
		depends on STATIC_IP
		string "Static GW Address"
		default "192.168.1.1"
		help
			Static GW Address for Station.

	config STATIC_NM_ADDRESS
		depends on STATIC_IP
		string "Static Netmask"
		default "255.255.255.0"
		help
			Static Netmask for Statione.

	config NTP_SERVER
		string "NTP Server"
		default "pool.ntp.org"
		help
			Hostname for NTP Server.

	config LOCAL_TIMEZONE
		int "Your TimeZone"
		range 0 23
		default 0
		help
			Your local timezone. When it is 0, Greenwich Mean Time.
			
	config BLINK_GPIO
		int "Blink GPIO number"
		range 0 48
		default 8 if IDF_TARGET_ESP32C3 || IDF_TARGET_ESP32H2
		default 18 if IDF_TARGET_ESP32S2
		default 33 if IDF_TARGET_ESP32
		default 33
		help
			GPIO number (IOxx) to blink on and off or the RMT signal for the addressable LED.
			Some GPIOs are used for other purposes (flash connections, etc.) and cannot be used to blink.		

endmenu

menu "OTA"

    config OTA_FIRMWARE_UPGRADE_URL
        string "Firmware Upgrade URL"
        default "https://192.168.1.6:8070/build/<project_name>.bin"
        help
            URL to download image file.
       
	config OTA_SERVER
		string "Server address"
		default "https://192.168.1.6:8070"
		help
			server which hosts the firmware image.
    config OTA_FIRMWARE_UPGRADE_URL_FROM_STDIN
        bool
        default y if OTA_FIRMWARE_UPGRADE_URL = "FROM_STDIN"

    config OTA_SKIP_COMMON_NAME_CHECK
        bool "Skip server certificate CN fieldcheck"
        default n
        help
            This allows you to skip the validation of OTA server certificate CN field.

    config OTA_SKIP_VERSION_CHECK
        bool "Skip firmware version check"
        default n
        help
            This allows you to skip the firmware version check.

    config OTA_RECV_TIMEOUT
        int "OTA Receive Timeout"
        default 5000
        help
            Maximum time for reception

    config OTA_ENABLE_PARTIAL_HTTP_DOWNLOAD
        bool "Enable partial HTTP download"
        default n
        help
            This enables use of Range header in esp_https_ota component.
            Firmware image will be downloaded over multiple HTTP requests.

    config OTA_HTTP_REQUEST_SIZE
        int "HTTP request size"
        default MBEDTLS_SSL_IN_CONTENT_LEN
        depends on OTA_ENABLE_PARTIAL_HTTP_DOWNLOAD
        help
            This options specifies HTTP request size. Number of bytes specified
            in this option will be downloaded in single HTTP request.
endmenu
```

## config & server/sdkconfig.defaults
```kconfig
# Default sdkconfig parameters to use the OTA
# partition table layout, with a 4MB flash size
CONFIG_ESPTOOLPY_FLASHSIZE_4MB=y
CONFIG_PARTITION_TABLE_CUSTOM=y
CONFIG_APP_PROJECT_VER_FROM_CONFIG=y
CONFIG_BOOTLOADER_APP_ROLLBACK_ENABLE=y
CONFIG_ESP_COREDUMP_ENABLE_TO_FLASH=y
CONFIG_ESP_TLS_CLIENT_SESSION_TICKETS=y
```

## sdkconfig.defaults
```kconfig
# Default sdkconfig parameters to use the OTA
# partition table layout, with a 4MB flash size
CONFIG_ESPTOOLPY_FLASHSIZE_4MB=y
CONFIG_PARTITION_TABLE_CUSTOM=y
CONFIG_APP_PROJECT_VER_FROM_CONFIG=y
CONFIG_BOOTLOADER_APP_ROLLBACK_ENABLE=y
```
